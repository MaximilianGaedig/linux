## Documentation/devicetree/bindings/iio/light/solteam,jsa1212.yaml
```yaml
# SPDX-License-Identifier: GPL-2.0-only
%YAML 1.2
---
$id: http://devicetree.org/schemas/iio/light/solteam,jsa1212.yaml#
$schema: http://devicetree.org/meta-schemas/core.yaml#

title: Solteam Opto JSA1212 I2C Proximity and Light sensor

maintainers:
  - Jack Matthews <jack@jackmatthe.ws>

allOf:
  - $ref: ../common.yaml#

properties:
  compatible:
    enum:
      - solteam,jsa1212
      - solteam,jsa1214

  reg:
    maxItems: 1

  vdd-supply: true

additionalProperties: false

required:
  - compatible
  - reg

examples:
  - |
    i2c {
        #address-cells = <1>;
        #size-cells = <0>;

        light-sensor@44 {
            compatible = "solteam,jsa1212";
            reg = <0x44>;
            
            vdd-supply = <&mt6323_vcn28_reg>;
        };
    };
```
