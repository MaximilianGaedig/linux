## Documentation/devicetree/bindings/clock/mediatek,mt8163-seninf.yaml
```yaml
# SPDX-License-Identifier: (GPL-2.0-only OR BSD-2-Clause)
%YAML 1.2
---
$id: http://devicetree.org/schemas/clock/mediatek,mt8163-seninf.yaml#
$schema: http://devicetree.org/meta-schemas/core.yaml#

title: MediaTek MT8163 camera sensor interface master clock

maintainers:
  - Maximilian Gaedig <mg@maximiliangaedig.com>

description:
  Timing generator 1 of the MT8163 camera sensor interface (SENINF) divides
  the CAMTG clock and drives the result onto the CMMCLK pad. Boards without a
  camera sensor can use the pad as a general purpose clock output.

properties:
  compatible:
    const: mediatek,mt8163-seninf

  reg:
    maxItems: 1

  clocks:
    items:
      - description: CAMTG clock, the source of the divider
      - description: imgsys timing generator gate
      - description: imgsys sensor interface gate
      - description: imgsys LARB2 SMI gate
      - description: imgsys camera SMI gate

  clock-names:
    items:
      - const: camtg
      - const: sen-tg
      - const: sen-cam
      - const: larb2-smi
      - const: cam-smi

  power-domains:
    maxItems: 1

  '#clock-cells':
    const: 0

  clock-output-names:
    maxItems: 1

required:
  - compatible
  - reg
  - clocks
  - clock-names
  - power-domains
  - '#clock-cells'

additionalProperties: false

examples:
  - |
    #include <dt-bindings/clock/mediatek,mt8163-imgsys.h>
    #include <dt-bindings/clock/mediatek,mt8163-topckgen.h>
    #include <dt-bindings/power/mediatek,mt8163-power-controller.h>

    clock-controller@15008000 {
        compatible = "mediatek,mt8163-seninf";
        reg = <0x15008000 0x1000>;
        clocks = <&topckgen CLK_TOP_CAMTG_SEL>,
                 <&imgsys CLK_IMG_SEN_TG>,
                 <&imgsys CLK_IMG_SEN_CAM>,
                 <&imgsys CLK_IMG_LARB2_SMI>,
                 <&imgsys CLK_IMG_CAM_SMI>;
        clock-names = "camtg", "sen-tg", "sen-cam", "larb2-smi", "cam-smi";
        power-domains = <&spm MT8163_POWER_DOMAIN_ISP>;
        #clock-cells = <0>;
    };
```

## Documentation/devicetree/bindings/leds/issi,is31fl3236.yaml
```yaml
# SPDX-License-Identifier: (GPL-2.0-only OR BSD-2-Clause)
%YAML 1.2
---
$id: http://devicetree.org/schemas/leds/issi,is31fl3236.yaml#
$schema: http://devicetree.org/meta-schemas/core.yaml#

title: ISSI IS31FL32xx and Si-En SN32xx LED controllers

maintainers:
  - Pavel Machek <pavel@kernel.org>
  - Lee Jones <lee@kernel.org>

description: |
  The IS31FL32xx/SN32xx family of LED controllers are I2C devices with
  multiple constant-current channels, each with independent 256-level PWM
  control. Each LED is represented as a sub-node of the device.

  For more product information please see the links below:
    http://www.issi.com/US/product-analog-fxled-driver.shtml
    http://www.si-en.com/product.asp?parentid=890

properties:
  compatible:
    enum:
      - issi,is31fl3216
      - issi,is31fl3218
      - issi,is31fl3235
      - issi,is31fl3236
      - issi,is31fl3236a
      - issi,is31fl3293
      - si-en,sn3216
      - si-en,sn3218

  reg:
    maxItems: 1

  "#address-cells":
    const: 1

  "#size-cells":
    const: 0

  issi,22khz-pwm:
    type: boolean
    description:
      Use a 22kHz PWM output frequency instead of the default 3kHz. Only
      supported by the IS31FL3236A; ignored on the other parts.

patternProperties:
  "^led@[1-9a-f][0-9a-f]*$":
    type: object
    $ref: common.yaml#
    unevaluatedProperties: false

    properties:
      reg:
        description: LED channel number, starting at 1
        minimum: 1
        maximum: 36

      led-max-microamp: true

    required:
      - reg

required:
  - compatible
  - reg
  - "#address-cells"
  - "#size-cells"

additionalProperties: false

examples:
  - |
    #include <dt-bindings/leds/common.h>

    i2c {
        #address-cells = <1>;
        #size-cells = <0>;

        led-controller@3c {
            compatible = "issi,is31fl3236";
            reg = <0x3c>;
            #address-cells = <1>;
            #size-cells = <0>;

            led@1 {
                reg = <1>;
                color = <LED_COLOR_ID_RED>;
                label = "EB:red:usr0";
            };

            led@2 {
                reg = <2>;
                color = <LED_COLOR_ID_GREEN>;
                label = "EB:green:usr1";
            };

            led@24 {
                reg = <36>;
                color = <LED_COLOR_ID_BLUE>;
                label = "EB:blue:usr35";
            };
        };
    };
```

## Documentation/devicetree/bindings/net/wireless/mediatek,connectivity-combo.yaml
```yaml
# SPDX-License-Identifier: (GPL-2.0-only OR BSD-2-Clause)
%YAML 1.2
---
$id: http://devicetree.org/schemas/net/wireless/mediatek,connectivity-combo.yaml#
$schema: http://devicetree.org/meta-schemas/core.yaml#

title: MediaTek connectivity combo chip control GPIOs

maintainers:
  - Maximilian Gaedig <mg@maximiliangaedig.com>

description:
  Board-level control lines of an external MediaTek connectivity combo chip
  such as the MT6625L, used by the WMT driver to power up and reset the chip
  before CONSYS talks to it.

properties:
  compatible:
    const: mediatek,connectivity-combo

  gpio_combo_pmu_en_pin-gpios:
    maxItems: 1
    description: Combo chip PMU enable

  gpio_combo_rst_pin-gpios:
    maxItems: 1
    description: Combo chip reset

  interrupts:
    maxItems: 1
    description: WiFi interrupt of an SDIO-attached combo chip

required:
  - compatible

additionalProperties: false

examples:
  - |
    #include <dt-bindings/gpio/gpio.h>

    connectivity-combo {
        compatible = "mediatek,connectivity-combo";
        gpio_combo_rst_pin-gpios = <&pio 60 GPIO_ACTIVE_HIGH>;
        gpio_combo_pmu_en_pin-gpios = <&pio 65 GPIO_ACTIVE_HIGH>;
    };
```

## Documentation/devicetree/bindings/net/wireless/mediatek,wifi.yaml
```yaml
# SPDX-License-Identifier: (GPL-2.0-only OR BSD-2-Clause)
%YAML 1.2
---
$id: http://devicetree.org/schemas/net/wireless/mediatek,wifi.yaml#
$schema: http://devicetree.org/meta-schemas/core.yaml#

title: MediaTek CONSYS WiFi AHB interface

maintainers:
  - Maximilian Gaedig <mg@maximiliangaedig.com>

description:
  WiFi host interface of the MediaTek connectivity subsystem (CONSYS). WLAN
  frames are exchanged between the AP and CONSYS through this block, which
  uses the AP DMA for bulk transfers.

properties:
  compatible:
    const: mediatek,wifi

  reg:
    maxItems: 1

  interrupts:
    maxItems: 1

  clocks:
    maxItems: 1

  clock-names:
    const: wifi-dma

required:
  - compatible
  - reg
  - interrupts
  - clocks
  - clock-names

additionalProperties: false

examples:
  - |
    #include <dt-bindings/clock/mediatek,mt8163-infracfg.h>
    #include <dt-bindings/interrupt-controller/arm-gic.h>
    #include <dt-bindings/interrupt-controller/irq.h>

    soc {
        #address-cells = <2>;
        #size-cells = <2>;

        wifi@180f0000 {
            compatible = "mediatek,wifi";
            reg = <0 0x180f0000 0 0x005c>;
            interrupts = <GIC_SPI 238 IRQ_TYPE_LEVEL_LOW>;
            clocks = <&infracfg CLK_INFRA_AP_DMA>;
            clock-names = "wifi-dma";
        };
    };
```

## Documentation/devicetree/bindings/reserved-memory/mediatek,consys-reserve-memory.yaml
```yaml
# SPDX-License-Identifier: (GPL-2.0-only OR BSD-2-Clause)
%YAML 1.2
---
$id: http://devicetree.org/schemas/reserved-memory/mediatek,consys-reserve-memory.yaml#
$schema: http://devicetree.org/meta-schemas/core.yaml#

title: MediaTek CONSYS reserved memory

maintainers:
  - Maximilian Gaedig <mg@maximiliangaedig.com>

description:
  Memory reserved for the MediaTek connectivity subsystem (CONSYS). CONSYS
  uses it to hold firmware, ROM patches and coredumps of the combo chip.
  The memory is not mapped by the operating system.

allOf:
  - $ref: reserved-memory.yaml

properties:
  compatible:
    const: mediatek,consys-reserve-memory

required:
  - compatible
  - no-map

unevaluatedProperties: false

examples:
  - |
    reserved-memory {
        #address-cells = <1>;
        #size-cells = <1>;
        ranges;

        consys-reserve-memory {
            compatible = "mediatek,consys-reserve-memory";
            no-map;
            size = <0x200000>;
            alignment = <0x200000>;
        };
    };
```

## Documentation/devicetree/bindings/serial/mediatek,btif.yaml
```yaml
# SPDX-License-Identifier: (GPL-2.0-only OR BSD-2-Clause)
%YAML 1.2
---
$id: http://devicetree.org/schemas/serial/mediatek,btif.yaml#
$schema: http://devicetree.org/meta-schemas/core.yaml#

title: MediaTek Bluetooth interface (BTIF)

maintainers:
  - Maximilian Gaedig <mg@maximiliangaedig.com>

description:
  BTIF is a UART-like interface between the AP and the MediaTek connectivity
  subsystem (CONSYS) that carries the Bluetooth HCI and WMT/STP traffic. The
  BTIF controller node describes the interface itself, while the TX and RX
  APDMA channels used for DMA transfers are described by separate
  mediatek,btif_tx and mediatek,btif_rx nodes.

properties:
  compatible:
    enum:
      - mediatek,btif
      - mediatek,btif_rx
      - mediatek,btif_tx

  reg:
    maxItems: 1

  interrupts:
    maxItems: 1

  clocks:
    items:
      - description: BTIF controller clock
      - description: AP DMA clock

  clock-names:
    items:
      - const: btifc
      - const: apdmac

required:
  - compatible
  - reg
  - interrupts

allOf:
  - if:
      properties:
        compatible:
          const: mediatek,btif
    then:
      required:
        - clocks
        - clock-names
    else:
      properties:
        clocks: false
        clock-names: false

additionalProperties: false

examples:
  - |
    #include <dt-bindings/clock/mediatek,mt8163-infracfg.h>
    #include <dt-bindings/interrupt-controller/arm-gic.h>
    #include <dt-bindings/interrupt-controller/irq.h>

    soc {
        #address-cells = <2>;
        #size-cells = <2>;

        serial@11000700 {
            compatible = "mediatek,btif_tx";
            reg = <0 0x11000700 0 0x80>;
            interrupts = <GIC_SPI 110 IRQ_TYPE_LEVEL_LOW>;
        };

        serial@11000780 {
            compatible = "mediatek,btif_rx";
            reg = <0 0x11000780 0 0x80>;
            interrupts = <GIC_SPI 111 IRQ_TYPE_LEVEL_LOW>;
        };

        serial@1100c000 {
            compatible = "mediatek,btif";
            reg = <0 0x1100c000 0 0x1000>;
            interrupts = <GIC_SPI 112 IRQ_TYPE_LEVEL_LOW>;
            clocks = <&infracfg CLK_INFRA_BTIF>, <&infracfg CLK_INFRA_AP_DMA>;
            clock-names = "btifc", "apdmac";
        };
    };
```

## Documentation/devicetree/bindings/soc/mediatek/mediatek,mt8163-consys.yaml
```yaml
# SPDX-License-Identifier: (GPL-2.0-only OR BSD-2-Clause)
%YAML 1.2
---
$id: http://devicetree.org/schemas/soc/mediatek/mediatek,mt8163-consys.yaml#
$schema: http://devicetree.org/meta-schemas/core.yaml#

title: MediaTek MT8163 connectivity subsystem (CONSYS)

maintainers:
  - Maximilian Gaedig <mg@maximiliangaedig.com>

description:
  CONSYS is the connectivity MCU subsystem integrated in the MT8163 SoC. It
  runs the firmware for an external MT6625L WiFi/Bluetooth/GPS/FM RF combo
  chip and exchanges control messages with the AP through the WMT/STP
  protocol. The AP powers the subsystem through the CONN power domain and the
  PMIC connectivity rails, and releases the MCU from reset through TOPRGU.

properties:
  compatible:
    const: mediatek,mt8163-consys

  reg:
    items:
      - description: CONN MCU configuration registers
      - description: AP reset generation unit (TOPRGU) registers
      - description: TOPCKGEN registers

  interrupts:
    items:
      - description: BGF (Bluetooth/GPS/FM) interrupt
      - description: CONSYS watchdog interrupt

  power-domains:
    maxItems: 1

  memory-region:
    maxItems: 1
    description:
      Reserved memory used by CONSYS for firmware, ROM patches and coredumps.

  clocks:
    maxItems: 1

  clock-names:
    const: consysbus

  resets:
    maxItems: 1

  reset-names:
    const: connsys

  pinctrl-0: true
  pinctrl-1: true
  pinctrl-2: true

  pinctrl-names:
    contains:
      const: consys_pins_default
    description:
      The consys_pins_default state muxes the antenna select pins of the
      combo chip.

  vcn18-supply:
    description: 1.8 V connectivity supply
  vcn28-supply:
    description: 2.8 V connectivity supply
  vcn33_bt-supply:
    description: 3.3 V Bluetooth supply
  vcn33_wifi-supply:
    description: 3.3 V WiFi supply

required:
  - compatible
  - reg
  - interrupts
  - power-domains
  - resets
  - reset-names
  - vcn18-supply
  - vcn28-supply
  - vcn33_bt-supply
  - vcn33_wifi-supply

additionalProperties: false

examples:
  - |
    #include <dt-bindings/interrupt-controller/arm-gic.h>
    #include <dt-bindings/interrupt-controller/irq.h>

    soc {
        #address-cells = <2>;
        #size-cells = <2>;

        consys@18070000 {
            compatible = "mediatek,mt8163-consys";
            reg = <0 0x18070000 0 0x0200>,
                  <0 0x10007000 0 0x0100>,
                  <0 0x10001000 0 0x1000>;
            interrupts = <GIC_SPI 237 IRQ_TYPE_LEVEL_LOW>,
                         <GIC_SPI 236 IRQ_TYPE_LEVEL_LOW>;
            power-domains = <&spm 7>;
            memory-region = <&consys_reserved_memory>;
            resets = <&watchdog 12>;
            reset-names = "connsys";
            pinctrl-names = "default", "consys_pins_default";
            pinctrl-0 = <&wifi_reset_init>;
            pinctrl-1 = <&consys_pins_default>;
            vcn18-supply = <&mt6323_vcn18_reg>;
            vcn28-supply = <&mt6323_vcn28_reg>;
            vcn33_bt-supply = <&mt6323_vcn33_bt_reg>;
            vcn33_wifi-supply = <&mt6323_vcn33_wifi_reg>;
        };
    };
```

## Documentation/devicetree/bindings/sound/amazon,biscuit-audio.yaml
```yaml
# SPDX-License-Identifier: (GPL-2.0-only OR BSD-2-Clause)
%YAML 1.2
---
$id: http://devicetree.org/schemas/sound/amazon,biscuit-audio.yaml#
$schema: http://devicetree.org/meta-schemas/core.yaml#

title: Amazon Echo Dot (2nd generation) sound card

maintainers:
  - Maximilian Gaedig <mg@maximiliangaedig.com>

description:
  Sound card of the Amazon Echo Dot (2nd generation, "biscuit"), based on the
  MT8163 AFE. Playback runs from the AFE DL1 front end through the I2S1 back
  end to a TLV320AIC32x4 codec driving an external amplifier. Capture comes
  from a microphone array FPGA read over SPI, with TLV320ADC3101 ADCs as its
  codecs.

properties:
  compatible:
    const: amazon,biscuit-audio

  mediatek,platform:
    $ref: /schemas/types.yaml#/definitions/phandle
    description: The MT8163 AFE

  mediatek,audio-codec:
    $ref: /schemas/types.yaml#/definitions/phandle
    description: The speaker codec

  amazon,mic-fpga:
    $ref: /schemas/types.yaml#/definitions/phandle
    description:
      The microphone array FPGA. Capture is disabled if it is absent.

  amazon,mic-codec:
    $ref: /schemas/types.yaml#/definitions/phandle-array
    minItems: 1
    maxItems: 4
    items:
      maxItems: 1
    description:
      The microphone ADCs feeding the FPGA, the TDM clock master first.

  amazon,hp-det-gpios:
    maxItems: 1
    description: Line-out jack insertion detect

  ext-spk-amp-supply:
    description: Enable of the external speaker amplifier

  pinctrl-0: true

  pinctrl-names:
    const: default

required:
  - compatible
  - mediatek,platform
  - mediatek,audio-codec

additionalProperties: false

examples:
  - |
    #include <dt-bindings/gpio/gpio.h>

    sound {
        compatible = "amazon,biscuit-audio";
        mediatek,platform = <&afe>;
        mediatek,audio-codec = <&aic32x4_codec>;
        amazon,mic-fpga = <&spi_pcm_fpga>;
        amazon,mic-codec = <&mic0_codec>, <&mic1_codec>,
                           <&mic2_codec>, <&mic3_codec>;
        amazon,hp-det-gpios = <&pio 26 GPIO_ACTIVE_HIGH>;
        ext-spk-amp-supply = <&ext_spk_amp>;
    };
```
