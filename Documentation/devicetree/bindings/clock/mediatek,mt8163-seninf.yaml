## arch/arm64/configs/biscuit_defconfig
```kconfig
# CONFIG_LOCALVERSION_AUTO is not set
# CONFIG_CROSS_MEMORY_ATTACH is not set
# CONFIG_CPU_ISOLATION is not set
CONFIG_LOG_BUF_SHIFT=21
CONFIG_NAMESPACES=y
# CONFIG_UTS_NS is not set
# CONFIG_TIME_NS is not set
# CONFIG_PID_NS is not set
CONFIG_BLK_DEV_INITRD=y
CONFIG_INITRAMFS_SOURCE="/home/user/proj/alexa2-rev/boot-test/initrd"
CONFIG_EXPERT=y
CONFIG_KEXEC=y
CONFIG_KEXEC_FILE=y
CONFIG_ARCH_MEDIATEK=y
# CONFIG_AMPERE_ERRATUM_AC03_CPU_38 is not set
# CONFIG_AMPERE_ERRATUM_AC04_CPU_23 is not set
# CONFIG_ARM64_ERRATUM_826319 is not set
# CONFIG_ARM64_ERRATUM_827319 is not set
# CONFIG_ARM64_ERRATUM_824069 is not set
# CONFIG_ARM64_ERRATUM_819472 is not set
# CONFIG_ARM64_ERRATUM_832075 is not set
# CONFIG_ARM64_ERRATUM_843419 is not set
# CONFIG_ARM64_ERRATUM_1024718 is not set
# CONFIG_ARM64_ERRATUM_1165522 is not set
# CONFIG_ARM64_ERRATUM_1319367 is not set
# CONFIG_ARM64_ERRATUM_1530923 is not set
# CONFIG_ARM64_ERRATUM_1463225 is not set
# CONFIG_ARM64_ERRATUM_1508412 is not set
# CONFIG_ARM64_ERRATUM_2051678 is not set
# CONFIG_ARM64_ERRATUM_2077057 is not set
# CONFIG_ARM64_ERRATUM_2658417 is not set
# CONFIG_ARM64_ERRATUM_2054223 is not set
# CONFIG_ARM64_ERRATUM_2067961 is not set
# CONFIG_ARM64_ERRATUM_2645198 is not set
# CONFIG_ARM64_ERRATUM_2966298 is not set
# CONFIG_ARM64_ERRATUM_3117295 is not set
# CONFIG_ARM64_ERRATUM_3194386 is not set
# CONFIG_ARM64_ERRATUM_4311569 is not set
# CONFIG_CAVIUM_ERRATUM_22375 is not set
# CONFIG_CAVIUM_ERRATUM_23154 is not set
# CONFIG_CAVIUM_ERRATUM_27456 is not set
# CONFIG_CAVIUM_ERRATUM_30115 is not set
# CONFIG_CAVIUM_TX2_ERRATUM_219 is not set
# CONFIG_FUJITSU_ERRATUM_010001 is not set
# CONFIG_HISILICON_ERRATUM_161600802 is not set
# CONFIG_HISILICON_ERRATUM_162100801 is not set
# CONFIG_QCOM_FALKOR_ERRATUM_1003 is not set
# CONFIG_QCOM_FALKOR_ERRATUM_1009 is not set
# CONFIG_QCOM_QDF2400_ERRATUM_0065 is not set
# CONFIG_QCOM_FALKOR_ERRATUM_E1041 is not set
# CONFIG_NVIDIA_CARMEL_CNP_ERRATUM is not set
# CONFIG_ROCKCHIP_ERRATUM_3568002 is not set
# CONFIG_ROCKCHIP_ERRATUM_3588001 is not set
# CONFIG_SOCIONEXT_SYNQUACER_PREITS is not set
# CONFIG_ARM64_TAGGED_ADDR_ABI is not set
# CONFIG_ARM64_HW_AFDBM is not set
# CONFIG_ARM64_RAS_EXTN is not set
# CONFIG_ARM64_CNP is not set
# CONFIG_ARM64_PTR_AUTH is not set
# CONFIG_ARM64_AMU_EXTN is not set
# CONFIG_ARM64_TLB_RANGE is not set
# CONFIG_ARM64_BTI is not set
# CONFIG_ARM64_E0PD is not set
# CONFIG_ARM64_EPAN is not set
# CONFIG_ARM64_POE is not set
# CONFIG_ARM64_GCS is not set
# CONFIG_ARM64_SVE is not set
CONFIG_CMDLINE="console=ttyS0,921600n8 console=ttyGS0 earlycon=uart8250,mmio32,0x11002000 keep_bootcon irqchip.gicv2_force_probe=1"
CONFIG_CMDLINE_FORCE=y
# CONFIG_EFI is not set
# CONFIG_SCHED_SMT is not set
# CONFIG_SCHED_CLUSTER is not set
# CONFIG_SCHED_MC is not set
# CONFIG_SECCOMP is not set
# CONFIG_STACKPROTECTOR is not set
# CONFIG_RELR is not set
# CONFIG_GCC_PLUGINS is not set
CONFIG_MODULES=y
CONFIG_MODULE_UNLOAD=y
CONFIG_MODULE_FORCE_UNLOAD=y
# CONFIG_BLOCK_LEGACY_AUTOLOAD is not set
# CONFIG_BLK_DEV_WRITE_MOUNTED is not set
# CONFIG_MQ_IOSCHED_DEADLINE is not set
# CONFIG_MQ_IOSCHED_KYBER is not set
# CONFIG_IOSCHED_BFQ is not set
# CONFIG_SWAP is not set
# CONFIG_SLAB_MERGE_DEFAULT is not set
# CONFIG_COMPAT_BRK is not set
# CONFIG_COMPACTION is not set
# CONFIG_MIGRATION is not set
CONFIG_NET=y
CONFIG_PACKET=y
CONFIG_UNIX=y
CONFIG_INET=y
CONFIG_BT=y
CONFIG_BT_RFCOMM=y
CONFIG_BT_HCIVHCI=y
CONFIG_CFG80211=y
CONFIG_MAC80211=y
CONFIG_DEVTMPFS=y
CONFIG_DEVTMPFS_MOUNT=y
# CONFIG_STANDALONE is not set
# CONFIG_PREVENT_FIRMWARE_BUILD is not set
CONFIG_EXTRA_FIRMWARE="i2s_to_spi_v34.bin"
CONFIG_EXTRA_FIRMWARE_DIR="firmware"
# CONFIG_ARM_SMCCC_SOC_ID is not set
# CONFIG_BLK_DEV is not set
CONFIG_MTK_CONNECTIVITY=y
CONFIG_MTK_COMBO=y
CONFIG_MTK_COMBO_BT=y
CONFIG_MTK_COMBO_WIFI=y
CONFIG_MTK_BTIF=y
CONFIG_NETDEVICES=y
CONFIG_KEYBOARD_GPIO=y
CONFIG_KEYBOARD_MT6779=y
# CONFIG_INPUT_MOUSE is not set
# CONFIG_LEGACY_PTYS is not set
# CONFIG_LEGACY_TIOCSTI is not set
# CONFIG_LDISC_AUTOLOAD is not set
CONFIG_SERIAL_8250=y
CONFIG_SERIAL_8250_CONSOLE=y
CONFIG_SERIAL_8250_MT6577=y
# CONFIG_HW_RANDOM is not set
# CONFIG_DEVPORT is not set
CONFIG_I2C=y
CONFIG_I2C_CHARDEV=y
CONFIG_I2C_MT65XX=y
CONFIG_SPI=y
CONFIG_SPI_MT65XX=y
CONFIG_SENSORS_IIO_HWMON=y
CONFIG_SENSORS_NTC_THERMISTOR=y
CONFIG_WATCHDOG=y
CONFIG_WATCHDOG_SYSFS=y
CONFIG_MFD_MT6397=y
CONFIG_MFD_SYSCON=y
CONFIG_REGULATOR_FIXED_VOLTAGE=y
CONFIG_REGULATOR_FAN53555=y
CONFIG_REGULATOR_MT6323=y
CONFIG_SOUND=y
CONFIG_SND=y
CONFIG_SND_SOC=y
CONFIG_SND_SOC_MT8163=y
CONFIG_SND_SOC_MT8163_BISCUIT=y
CONFIG_SND_SOC_MT8163_SPI_FPGA=y
CONFIG_SND_SOC_TLV320ADC3XXX=y
CONFIG_SND_SOC_TLV320AIC3X_I2C=y
CONFIG_SND_SIMPLE_CARD=y
# CONFIG_HID_SUPPORT is not set
CONFIG_USB_MTU3=y
CONFIG_USB_MUSB_HDRC=y
CONFIG_USB_MUSB_MEDIATEK=y
CONFIG_USB_INVENTRA_DMA=y
CONFIG_NOP_USB_XCEIV=y
CONFIG_USB_GADGET=y
CONFIG_U_SERIAL_CONSOLE=y
CONFIG_USB_CONFIGFS=y
CONFIG_USB_CONFIGFS_SERIAL=y
CONFIG_USB_CONFIGFS_ACM=y
CONFIG_USB_CONFIGFS_NCM=y
CONFIG_USB_CONFIGFS_ECM=y
CONFIG_USB_CONFIGFS_RNDIS=y
CONFIG_USB_CONFIGFS_EEM=y
CONFIG_MMC=y
CONFIG_MMC_MTK=y
CONFIG_NEW_LEDS=y
CONFIG_LEDS_CLASS=y
CONFIG_LEDS_CLASS_MULTICOLOR=y
CONFIG_LEDS_IS31FL32XX=y
CONFIG_LEDS_GROUP_MULTICOLOR=y
CONFIG_RTC_CLASS=y
# CONFIG_VIRTIO_MENU is not set
# CONFIG_VHOST_MENU is not set
# CONFIG_SURFACE_PLATFORMS is not set
# CONFIG_ARM64_PLATFORM_DEVICES is not set
CONFIG_COMMON_CLK_MT8196_MFGCFG=y
CONFIG_COMMON_CLK_MT8196_MMSYS=y
CONFIG_COMMON_CLK_MT8196_VDECSYS=y
CONFIG_COMMON_CLK_MT8196_VENCSYS=y
# CONFIG_ARM_ARCH_TIMER_EVTSTREAM is not set
# CONFIG_FSL_ERRATUM_A008585 is not set
# CONFIG_HISILICON_ERRATUM_161010101 is not set
# CONFIG_ARM64_ERRATUM_858921 is not set
# CONFIG_IOMMU_SUPPORT is not set
CONFIG_MTK_PMIC_WRAP=y
CONFIG_IIO=y
CONFIG_MEDIATEK_MT6577_AUXADC=y
CONFIG_TSL2583=y
CONFIG_PHY_MTK_TPHY=y
CONFIG_EXT4_FS=y
# CONFIG_DNOTIFY is not set
# CONFIG_INOTIFY_USER is not set
CONFIG_TMPFS=y
# CONFIG_MISC_FILESYSTEMS is not set
CONFIG_LIST_HARDENED=y
# CONFIG_SYMBOLIC_ERRNAME is not set
# CONFIG_SECTION_MISMATCH_WARN_ONLY is not set
CONFIG_MAGIC_SYSRQ=y
CONFIG_DEBUG_FS=y
CONFIG_SLUB_DEBUG_ON=y
CONFIG_DEBUG_OBJECTS=y
CONFIG_DEBUG_OBJECTS_TIMERS=y
CONFIG_DEBUG_OBJECTS_WORK=y
CONFIG_DEBUG_MEMORY_INIT=y
CONFIG_PANIC_ON_OOPS=y
CONFIG_PANIC_TIMEOUT=3
CONFIG_DEBUG_WW_MUTEX_SLOWPATH=y
CONFIG_DEBUG_RWSEMS=y
CONFIG_DEBUG_ATOMIC_SLEEP=y
# CONFIG_FTRACE is not set
# CONFIG_STRICT_DEVMEM is not set
# CONFIG_RUNTIME_TESTING_MENU is not set
```

## arch/arm64/configs/mt8163_biscuit_defconfig
```kconfig
# CONFIG_LOCALVERSION_AUTO is not set
# CONFIG_CROSS_MEMORY_ATTACH is not set
# CONFIG_CPU_ISOLATION is not set
# CONFIG_UTS_NS is not set
# CONFIG_TIME_NS is not set
# CONFIG_PID_NS is not set
CONFIG_BLK_DEV_INITRD=y
CONFIG_ARCH_MEDIATEK=y
# CONFIG_AMPERE_ERRATUM_AC03_CPU_38 is not set
# CONFIG_AMPERE_ERRATUM_AC04_CPU_23 is not set
# CONFIG_ARM64_ERRATUM_826319 is not set
# CONFIG_ARM64_ERRATUM_827319 is not set
# CONFIG_ARM64_ERRATUM_824069 is not set
# CONFIG_ARM64_ERRATUM_819472 is not set
# CONFIG_ARM64_ERRATUM_832075 is not set
# CONFIG_ARM64_ERRATUM_843419 is not set
# CONFIG_ARM64_ERRATUM_1024718 is not set
# CONFIG_ARM64_ERRATUM_1165522 is not set
# CONFIG_ARM64_ERRATUM_1319367 is not set
# CONFIG_ARM64_ERRATUM_1530923 is not set
# CONFIG_ARM64_ERRATUM_1463225 is not set
# CONFIG_ARM64_ERRATUM_1508412 is not set
# CONFIG_ARM64_ERRATUM_2051678 is not set
# CONFIG_ARM64_ERRATUM_2077057 is not set
# CONFIG_ARM64_ERRATUM_2658417 is not set
# CONFIG_ARM64_ERRATUM_2054223 is not set
# CONFIG_ARM64_ERRATUM_2067961 is not set
# CONFIG_ARM64_ERRATUM_2645198 is not set
# CONFIG_ARM64_ERRATUM_2966298 is not set
# CONFIG_ARM64_ERRATUM_3117295 is not set
# CONFIG_ARM64_ERRATUM_3194386 is not set
# CONFIG_ARM64_ERRATUM_4311569 is not set
# CONFIG_CAVIUM_ERRATUM_22375 is not set
# CONFIG_CAVIUM_ERRATUM_23154 is not set
# CONFIG_CAVIUM_ERRATUM_27456 is not set
# CONFIG_CAVIUM_ERRATUM_30115 is not set
# CONFIG_CAVIUM_TX2_ERRATUM_219 is not set
# CONFIG_FUJITSU_ERRATUM_010001 is not set
# CONFIG_HISILICON_ERRATUM_161600802 is not set
# CONFIG_HISILICON_ERRATUM_162100801 is not set
# CONFIG_QCOM_FALKOR_ERRATUM_1003 is not set
# CONFIG_QCOM_FALKOR_ERRATUM_1009 is not set
# CONFIG_QCOM_QDF2400_ERRATUM_0065 is not set
# CONFIG_QCOM_FALKOR_ERRATUM_E1041 is not set
# CONFIG_NVIDIA_CARMEL_CNP_ERRATUM is not set
# CONFIG_ROCKCHIP_ERRATUM_3568002 is not set
# CONFIG_ROCKCHIP_ERRATUM_3588001 is not set
# CONFIG_SOCIONEXT_SYNQUACER_PREITS is not set
# CONFIG_ARM64_TAGGED_ADDR_ABI is not set
# CONFIG_ARM64_HW_AFDBM is not set
# CONFIG_ARM64_RAS_EXTN is not set
# CONFIG_ARM64_CNP is not set
# CONFIG_ARM64_PTR_AUTH is not set
# CONFIG_ARM64_AMU_EXTN is not set
# CONFIG_ARM64_TLB_RANGE is not set
# CONFIG_ARM64_BTI is not set
# CONFIG_ARM64_E0PD is not set
# CONFIG_ARM64_EPAN is not set
# CONFIG_ARM64_POE is not set
# CONFIG_ARM64_GCS is not set
# CONFIG_ARM64_SVE is not set
CONFIG_CMDLINE="console=ttyS0,921600n8 console=ttyGS0 earlycon"
CONFIG_CMDLINE_FORCE=y
# CONFIG_EFI is not set
# CONFIG_SUSPEND is not set
CONFIG_PM=y
# CONFIG_SCHED_SMT is not set
# CONFIG_SCHED_CLUSTER is not set
# CONFIG_SCHED_MC is not set
# CONFIG_SECCOMP is not set
# CONFIG_STACKPROTECTOR is not set
# CONFIG_RELR is not set
# CONFIG_GCC_PLUGINS is not set
CONFIG_MODULES=y
CONFIG_MODULE_UNLOAD=y
# CONFIG_BLOCK_LEGACY_AUTOLOAD is not set
# CONFIG_BLK_DEV_WRITE_MOUNTED is not set
# CONFIG_MQ_IOSCHED_DEADLINE is not set
# CONFIG_MQ_IOSCHED_KYBER is not set
# CONFIG_IOSCHED_BFQ is not set
# CONFIG_SWAP is not set
# CONFIG_SLAB_MERGE_DEFAULT is not set
# CONFIG_COMPAT_BRK is not set
# CONFIG_COMPACTION is not set
# CONFIG_MIGRATION is not set
CONFIG_NET=y
CONFIG_INET=y
CONFIG_BT=y
CONFIG_BT_HCIUART=y
CONFIG_CFG80211=y
CONFIG_DEVTMPFS=y
CONFIG_DEVTMPFS_MOUNT=y
# CONFIG_STANDALONE is not set
# CONFIG_PREVENT_FIRMWARE_BUILD is not set
# CONFIG_ARM_SMCCC_SOC_ID is not set
# CONFIG_BLK_DEV is not set
CONFIG_MTK_CONNECTIVITY=y
CONFIG_MTK_COMBO=y
CONFIG_MTK_COMBO_BT=y
CONFIG_MTK_COMBO_WIFI=y
CONFIG_MTK_BTIF=y
CONFIG_KEYBOARD_GPIO=y
CONFIG_KEYBOARD_MT6779=y
# CONFIG_INPUT_MOUSE is not set
# CONFIG_LEGACY_PTYS is not set
# CONFIG_LEGACY_TIOCSTI is not set
# CONFIG_LDISC_AUTOLOAD is not set
CONFIG_SERIAL_8250=y
CONFIG_SERIAL_8250_CONSOLE=y
CONFIG_SERIAL_8250_MT6577=y
# CONFIG_HW_RANDOM is not set
# CONFIG_DEVMEM is not set
# CONFIG_DEVPORT is not set
# CONFIG_HWMON is not set
CONFIG_MFD_MT6397=y
CONFIG_REGULATOR_FIXED_VOLTAGE=y
CONFIG_REGULATOR_MT6323=y
CONFIG_SOUND=y
CONFIG_SND=y
CONFIG_SND_SOC=y
CONFIG_SND_SOC_MT8163=y
# CONFIG_HID_SUPPORT is not set
CONFIG_USB_MTU3=y
CONFIG_USB_GADGET=y
CONFIG_USB_G_SERIAL=y
CONFIG_MMC=y
CONFIG_MMC_MTK=y
CONFIG_NEW_LEDS=y
CONFIG_LEDS_CLASS=y
CONFIG_RTC_CLASS=y
# CONFIG_VIRTIO_MENU is not set
# CONFIG_VHOST_MENU is not set
# CONFIG_SURFACE_PLATFORMS is not set
# CONFIG_ARM64_PLATFORM_DEVICES is not set
CONFIG_COMMON_CLK_MT8196_MFGCFG=y
CONFIG_COMMON_CLK_MT8196_MMSYS=y
CONFIG_COMMON_CLK_MT8196_VDECSYS=y
CONFIG_COMMON_CLK_MT8196_VENCSYS=y
# CONFIG_ARM_ARCH_TIMER_EVTSTREAM is not set
# CONFIG_FSL_ERRATUM_A008585 is not set
# CONFIG_HISILICON_ERRATUM_161010101 is not set
# CONFIG_ARM64_ERRATUM_858921 is not set
# CONFIG_IOMMU_SUPPORT is not set
CONFIG_MTK_PMIC_WRAP=y
CONFIG_IIO=y
CONFIG_PHY_MTK_TPHY=y
# CONFIG_DNOTIFY is not set
# CONFIG_INOTIFY_USER is not set
CONFIG_TMPFS=y
# CONFIG_MISC_FILESYSTEMS is not set
# CONFIG_CRYPTO_AES is not set
# CONFIG_SYMBOLIC_ERRNAME is not set
# CONFIG_SECTION_MISMATCH_WARN_ONLY is not set
# CONFIG_RUNTIME_TESTING_MENU is not set
```

## drivers/misc/mediatek/Kconfig
```kconfig
menuconfig MTK_CONNECTIVITY
	bool "MediaTek MT66xx combo connectivity support"
	depends on ARCH_MEDIATEK || COMPILE_TEST
	help
	  Support for MediaTek's MT66xx family combo connectivity chips
	  (WiFi + Bluetooth + GPS + FM), as found glued to the CONSYS
	  subsystem of MT81xx/MT76xx SoCs.  Say Y here to get the
	  per-subsystem options below.

	  If unsure, say N.

if MTK_CONNECTIVITY

config MTK_COMBO
	tristate "MT66xx combo chip WMT/STP core"
	depends on OF
	select ZLIB_DEFLATE
	help
	  The Wireless Management Team (WMT) / Serial Transport Protocol
	  (STP) core.  This is the shared transport that muxes the WiFi,
	  Bluetooth, GPS and FM function chunks of the combo chip over a
	  single logical link to the CONSYS co-processor, and which does
	  the power-on sequencing and firmware/ROM-patch download.

	  Every other option here depends on this one.

	  To compile this as a module, choose M here: the modules will be
	  called mtk_stp_wmt_soc, mtk_stp_bt_soc and mtk_wmt_wifi_soc.

config MTK_COMBO_CHIP
	string "Combo chip model"
	depends on MTK_COMBO
	default "CONSYS_8163"
	help
	  Which member of the combo chip family is fitted, in MediaTek's own
	  naming.  The driver Makefiles pattern-match on this: a "CONSYS_*"
	  value selects the SoC-integrated connectivity subsystem paths (as
	  opposed to a discrete SDIO/UART combo chip), and everything except
	  MT6630/CONSYS_6797 selects the gen2 WiFi driver rather than gen3.

	  "CONSYS_8163" is what Amazon's own biscuit_defconfig sets for the
	  MT6625L-on-MT8163 wiring this port targets; leave it alone unless
	  you are building for different silicon.

config MTK_COMBO_BT
	tristate "MT66xx combo chip Bluetooth (/dev/stpbt)"
	depends on MTK_COMBO
	depends on BT
	help
	  Exposes the combo chip's Bluetooth function as a character
	  device, /dev/stpbt.  Note that this is *not* an in-kernel
	  struct hci_dev driver: a userspace helper is expected to open
	  /dev/stpbt and attach it to the HCI stack as a UART line
	  discipline.

config MTK_COMBO_WIFI
	tristate "MT66xx combo chip WiFi (gen2 MAC driver)"
	depends on MTK_COMBO
	depends on CFG80211
	select WIRELESS_EXT
	select WEXT_PRIV
	select CFG80211_WEXT
	help
	  The gen2 WiFi MAC driver for the MT66xx combo chips.  This is a
	  self-contained vendor stack -- it implements struct net_device
	  and a struct cfg80211_ops table directly and does not use
	  mac80211.  It also still exposes a pile of wireless-extensions
	  private ioctls, hence the WEXT selects above.

	  To compile this as a module, choose M here: the module will be
	  called wlan_gen2.

config MTK_WAPI_SUPPORT
	bool "WAPI support in the MT66xx WiFi driver"
	depends on MTK_COMBO_WIFI
	help
	  Build in support for WAPI, the Chinese national WLAN security
	  standard.  Only useful on devices sold in that market.

source "drivers/misc/mediatek/btif/Kconfig"

endif # MTK_CONNECTIVITY
```
