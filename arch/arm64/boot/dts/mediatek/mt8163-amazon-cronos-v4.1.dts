// SPDX-License-Identifier: GPL-2.0-only OR MIT
/*
 * Copyright (c) 2025-2026 Ben Grisdale <bengris32@protonmail.ch>
 * Copyright (c) 2025-2026 Jack Matthews <jack@jackmatthe.ws>
 */

/dts-v1/;
#include "mt8163-amazon-cronos.dtsi"

/ {
	model = "Amazon Echo Show 5 (2021) (v4.1)";
	compatible = "amazon,cronos-v4.1", "amazon,cronos", "mediatek,mt8163";
	chassis-type = "embedded";

	/* Needed by stock bootloader */
	version = "pvt_4_1";
};
